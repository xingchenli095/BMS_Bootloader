do ..\source\boards\${BOARD}\${DERIVATE}.cmm ..\output\bin\${BINARY}

