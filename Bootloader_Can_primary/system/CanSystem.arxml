AUTOSAR XML (schema 00047)
package /CanSystem
  system CanSystem: system-version=1.0.0
package /CanSystem/CLUSTERS
  can cluster CanNetwork: speed=500
    can physical channel CanChannel: comm-connectors=[Conn_DebugNode, Conn_EcuTestNode]
package /CanSystem/ECUINSTANCES
  ecu instance DebugNode: com-configuration-gw-time-base=0.005, com-configuration-rx-time-base=0.005, com-configuration-tx-time-base=0.005, com-enable-mdt-for-cyclic-transmission=false, sleep-mode-supported=false, wake-up-over-bus-supported=false
    can communication controller DebugNode
    can communication connector Conn_DebugNode: comm-controller=DebugNode
  ecu instance EcuTestNode: com-configuration-gw-time-base=0.005, com-configuration-rx-time-base=0.005, com-configuration-tx-time-base=0.005, com-enable-mdt-for-cyclic-transmission=true, sleep-mode-supported=false, wake-up-over-bus-supported=false
    can communication controller EcuTestNode
    can communication connector Conn_EcuTestNode: comm-controller=EcuTestNode
